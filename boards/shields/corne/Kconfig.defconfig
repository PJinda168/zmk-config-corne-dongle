## boards/shields/corne/Kconfig.defconfig
```kconfig
## -----------------------------------------------------------------
if SHIELD_CORNE_LEFT || SHIELD_CORNE_DONGLE

config ZMK_KEYBOARD_NAME
    default "Corne"

config ZMK_SPLIT_ROLE_CENTRAL
    default y

config ZMK_SPLIT_BLE_CENTRAL_PERIPHERALS
    default 2

config BT_MAX_CONN
    default 2

config BT_MAX_PAIRED
    default 2

config ZMK_STUDIO
    default y

config ZMK_STUDIO_LOCKING
    default n  

config ZMK_SLEEP
    default n

endif ## SHIELD_CORNE_DONGLE

## -----------------------------------------------------------------
if SHIELD_CORNE_LEFT || SHIELD_CORNE_RIGHT 

config ZMK_SPLIT_ROLE_CENTRAL
    default n

endif ## SHIELD_CORNE_LEFT || SHIELD_CORNE_RIGHT

## -----------------------------------------------------------------
if SHIELD_CORNE_LEFT || SHIELD_CORNE_RIGHT || SHIELD_CORNE_DONGLE || SHIELD_CORNE_PERIPHERAL_LEFT

config ZMK_SPLIT
    default y

if ZMK_DISPLAY

config I2C
    default y

config SSD1306
    default y

endif # ZMK_DISPLAY
    
## ------------------

if LVGL

config LV_Z_VDB_SIZE
    default 64

config LV_DPI_DEF
    default 148

config LV_Z_BITS_PER_PIXEL
    default 1

choice LV_COLOR_DEPTH
    default LV_COLOR_DEPTH_1
endchoice

endif # LVGL

endif
```

## config/west.yml
```yaml
manifest:
  remotes:
    - name: zmkfirmware
      url-base: https://github.com/zmkfirmware
    - name: m165437
      url-base: https://github.com/M165437
    - name: carrefinho                            # <--- add this
      url-base: https://github.com/carrefinho     # <--- and this
     # nice_oled
    - name: mctechnology17
      url-base: https://github.com/mctechnology17
  projects:
    - name: zmk
      remote: zmkfirmware
      revision: main
      import: app/west.yml
    - name: nice-view-gem
      remote: m165437
      revision: main
    - name: prospector-zmk-module                 # <--- and these
      remote: carrefinho                          # <---
      revision: main                              # <---
    # nice_oled
    - name: zmk-nice-oled
      remote: mctechnology17
      revision: main
  self:
    path: config
```
